#include "OLED.h"

OLED Display;
void Demo();
void draw_lines(void);

void draw_rects(void);

void draw_circles(void);

void draw_wheels(void);

void draw_lines_flower1(void);

void draw_lines_flower(void);
void Rainbow(void);


const unsigned char Icon24x24x64k[] ={
  0xff,0xff,0xff,0xff,0xff,0xff,0xff,0xff,0xff,0xff,0xff,0xff,0xff,0xff,0xff,0xff,
  0x7b,0xf7,0xd6,0xee,0x73,0xe6,0x52,0xe6,0x51,0xe6,0x93,0xe6,0xd6,0xee,0x7b,0xf7,
  0xff,0xff,0xff,0xff,0xff,0xff,0xff,0xff,0xff,0xff,0xff,0xff,0xff,0xff,0xff,0xff,
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  0xff,0xff,0xff,0xff,0xff,0xff,0xff,0xff,0xff,0xff,0xff,0xff,0xff,0xff,0xff,0xff,
};

char Buff[255];
int BuffPtr=0;


void setup() {
        Display.setup();
          Serial.begin(115200);
          Serial.println("started");
          Buff[0]=0;
}

void loop() {
    Demo();
}
void Demo() {
long i;

  Display.Clear_Window(0x00,0x83,0x00,0x83);
  delay(10);
  Display.SetColour(OLED_BLUE);
  Display.printxy(100,80,"A");
  delay(500);
  while(1)
  if (Serial)   {
    char ch = Serial.read();
    if (ch==-1) {
        if (BuffPtr!=0) {
            BuffPtr = 0;         
            Display.DrawPath(Buff);
        }
        continue;
    }
delay(10);
    Buff[BuffPtr++]=ch;
    if(BuffPtr>200) BuffPtr=0;
    Buff[BuffPtr]=0;    
  }

  return;
  draw_lines_flower1();
  delay(100);
  draw_lines_flower();
  delay(100);
  draw_lines();

  Display.Clear_Window(0x00,0x83,0x00,0x83);
  delay(10);
  draw_rects();

  Display.Clear_Window(0x00,0x83,0x00,0x83);
  delay(10);
  draw_circles();

  Display.Clear_Window(0x00,0x83,0x00,0x83);
  delay(10);
  draw_wheels();

  // do filling color
  Display.SetFill(true);
  for(int i=0;i<8;i++)
  {
  Display.SetFillColour(MAKECOLOR64k(i & 4 ? 0xff : 0x00,i & 2 ? 0xff : 0x00,i & 1 ? 0xff : 0x00));
  Display.Fill_Block(0,0,Max_Column,Max_Row);
  delay(500);
  }
  Display.Clear_Window(0x00,0x83,0x00,0x83);
  delay(10);
  Rainbow();
  delay(500);

  // show icon
 Display.Show_64k_Pattern_LittleEndia((unsigned char *)Icon24x24x64k,50,50,50+23,50+23);
delay(500);
}
void draw_lines(void)
{
  unsigned char x1,y1,x2,y2;
  unsigned short int i;

  // draw unfilled rectangles
  Display.SetFill(false);
  for (i=0; i<2000; i++) {
    x1=rand()%127;
    x2=rand()%127;
    y1=rand()%127;
    y2=rand()%127;
    Display.SetColour(MAKECOLOR64k(rand(), rand(),rand()));
    Display.Line(min(x1,x2),min(y1,y2),max(x1,x2),max(y1,y2));
  }
}

void draw_rects(void)
{
  unsigned char x1,y1,x2,y2;
  unsigned short int i;

  // draw unfilled rectangles
  Display.SetFill(false);
  for (i=0; i<2000; i++) {
    x1=rand()%127;
    x2=rand()%127;
    y1=rand()%127;
    y2=rand()%127;
    Display.SetColour(MAKECOLOR64k(rand(), rand(),rand()));
    Display.SetFillColour(MAKECOLOR64k(rand(), rand(),rand()));
    Display.Rectangle(min(x1,x2),min(y1,y2),max(x1,x2),max(y1,y2));
  }

  // draw filled rectangles
  Display.SetFill(true);
  for (i=0; i<2000; i++) {
    x1=rand()%127;
    x2=rand()%127;
    y1=rand()%127;
    y2=rand()%127;
    Display.SetColour(MAKECOLOR64k(rand(), rand(),rand()));
    Display.SetFillColour(MAKECOLOR64k(rand(), rand(),rand()));
    Display.Rectangle(min(x1,x2),min(y1,y2),max(x1,x2),max(y1,y2));
  }
}

void draw_circles(void)
{
  unsigned char x,y,r;
  unsigned short int i;

  // draw unfilled circles
  Display.SetFill(false);
  for (i=0; i<2000; i++) {
    x=rand()%128;
    y=rand()%128;
    r=rand()%60;
    Display.SetColour(MAKECOLOR64k(rand(), rand(),rand()));
    Display.Circle(x, y, r);
  }

  // draw filled circles
  Display.SetFill(true);

  for (i=0; i<2000; i++) {
    x=rand()%128;
    y=rand()%128;
    r=rand()%60;
    Display.SetColour(MAKECOLOR64k(rand(), rand(),rand()));
    Display.SetFillColour(MAKECOLOR64k(rand(), rand(),rand()));
    Display.Circle(x, y, r);
  }
}

void draw_wheels(void)
{
  float al,pi=3.14159;
  unsigned char l=25, x,y,i;

  Display.SetFill(false);
  for (i=0; i<30; i++) {
    for (al=0; al<2*pi; al+=pi/24.0) {
      x=(unsigned char)(l*cos(al))+64;
      y=(unsigned char)(64-l*sin(al));
      Display.SetColour(MAKECOLOR64k(rand(), rand(),rand()));
      Display.Circle(x,y, 25);
    }
  }
}

void draw_lines_flower1(void)
{
  float pi=3.14159,al,f;
  unsigned char x1,y1,x2,y2, d=30;

  for(al=0.0; al<pi*2; al+=pi/360) {
    f=(d*(1.0+1.0/4.0*cos(12.0*al)))*(1.0+sin(4.0*al));
    x1=64+f*cos(al);
    x2=64+f*cos(al+pi/5.0);
    y1=64-f*sin(al);
    y2=64-f*sin(al+pi/5.0);
    Display.SetColour(MAKECOLOR64k(rand(), rand(),rand()));
    Display.Line(x1,y1,x2,y2);
  }
}

void draw_lines_flower(void)
{
  float pi=3.14159,al,f;
  unsigned char x1,y1,x2,y2, d=30;

  for(al=0.0; al<pi*2; al+=pi/360) {
    f=(d*(1.0+sin(4.0*al)));
    x1=64+f*cos(al);
    x2=64+f*cos(al+pi/5.0);
    y1=64-f*sin(al);
    y2=64-f*sin(al+pi/5.0);
    Display.SetColour(MAKECOLOR64k(rand(), rand(),rand()));
    Display.Line(x1,y1,x2,y2);
  }
}

//-=-=-=-=-=-=-=-=-=-=-=-=-=-=-=-=-=-=-=-=-=-=-=-=-=-=-=-=-=-=-=-=-=-=-=
//  Show Color Bar (Full Screen)
//-=-=-=-=-=-=-=-=-=-=-=-=-=-=-=-=-=-=-=-=-=-=-=-=-=-=-=-=-=-=-=-=-=-=-=
void Rainbow(void)
{
    Display.SetFill(true);
    unsigned char col = 0;
    unsigned short fc[8] = {MAKECOLOR64k(0xFF,0xFF,0xFF),// white
                            MAKECOLOR64k(0xFF,0xFF,0x0),// yellow
                            MAKECOLOR64k(0xFF,0x0,0xFF),// purple
                            MAKECOLOR64k(0x0,0xff,0xFF),// cyan
                            MAKECOLOR64k(0xFF,0x0,0x00),// red
                            MAKECOLOR64k(0x00,0xff,0x00),// green
                            MAKECOLOR64k(0x00,0x00,0xFF),// blue
                            MAKECOLOR64k(0x00,0x0,0x00)// black

                            };

  // White => Column 1~16
    for(int i=0;i<8;i++)    {
    Display.SetFillColour(fc[i]);
    Display.Rectangle(col,0,col+15,Max_Row);
    col += 16;
    }
}
void Rainbow1(void)
{
    Display.SetFill(false);
    int ncols = 3;
    int colw = Max_Column / ncols;
        for(int c=0;c<ncols;c++)    {
            for(int r=0;r<Max_Row;r++)  {
                Display.SetColour(255/(c+1),0,r*2);
                Display.Line(colw*c,r,colw*(c+1)-1,r);
            }
        }
}
